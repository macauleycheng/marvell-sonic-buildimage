## platform/marvell-prestera/sonic_fit.its
```
/dts-v1/;
  
/ {
    description = "U-Boot fitImage for SONIC Marvell Arm64";
    #address-cells = <1>;
  
    images {
        kernel_ac5x {
            description = "Linux Kernel for AC5x";
            data = /incbin/("/boot/vmlinuz-6.12.41+deb13-sonic-arm64");
            type = "kernel";
            arch = "arm64";
            os = "linux";
            compression = "none";
            load = <0x2 0x2080000>;
            entry = <0x2 0x2080000>;
            hash@1 {
                algo = "sha1";
            };
        };
        kernel_cn9131 {
            description = "Linux Kernel - cn9131";
            data = /incbin/("/boot/vmlinuz-6.12.41+deb13-sonic-arm64");
            type = "kernel";
            arch = "arm64";
            os = "linux";
            compression = "none";
            load = <0x1000000>;
            entry = <0x1000000>;
            hash@1 {
                algo = "sha1";
            };
        };
        kernel_7215_a1 {
            description = "Linux Kernel - 7215_a1/Nokia";
            data = /incbin/("/boot/vmlinuz-6.12.41+deb13-sonic-arm64");
            type = "kernel";
            arch = "arm64";
            os = "linux";
            compression = "none";
            load = <0x12000000>;
            entry = <0x12000000>;
            hash@1 {
                algo = "sha1";
            };
        };

        /* Accton ECS5550-30X (CN9130 + Aldrin2): addresses match the vendor
         * image so the same U-Boot env (fit_addr=0x10000000) boots both. */
        kernel_aldrin2 {
            description = "Linux Kernel - Aldrin2/ECS5550";
            data = /incbin/("/boot/vmlinuz-6.12.41+deb13-sonic-arm64");
            type = "kernel";
            arch = "arm64";
            os = "linux";
            compression = "none";
            load = <0x5480000>;
            entry = <0x5480000>;
            hash@1 {
                algo = "sha1";
            };
        };

        ramdisk_ac5x {
            description = "ramdisk for AC5x";
            data = /incbin/("/boot/initrd.img-6.12.41+deb13-sonic-arm64");
            type = "ramdisk";
            arch = "arm64";
            os = "linux";
            compression = "none";
            load = <0x2 0x6000000>;
            entry = <0x2 0x6000000>;
            hash@1 {
                algo = "sha1";
            };
        };
        ramdisk_cn9131 {
            description = "ramdisk - cn9131";
            data = /incbin/("/boot/initrd.img-6.12.41+deb13-sonic-arm64");
            type = "ramdisk";
            arch = "arm64";
            os = "linux";
            compression = "none";
            load = <0x6000000>;
            entry = <0x6000000>;
            hash@1 {
                algo = "sha1";
            };
        };
        ramdisk_7215_a1 {
            description = "ramdisk - 7215_a1/Nokia";
            data = /incbin/("/boot/initrd.img-6.12.41+deb13-sonic-arm64");
            type = "ramdisk";
            arch = "arm64";
            os = "linux";
            compression = "none";
            load = <0x18000000>;
            entry = <0x18000000>;
            hash@1 {
                algo = "sha1";
            };
        };
        /* No load address: U-Boot uses the ramdisk in place inside the FIT */
        ramdisk_aldrin2 {
            description = "ramdisk - Aldrin2/ECS5550";
            data = /incbin/("/boot/initrd.img-6.12.41+deb13-sonic-arm64");
            type = "ramdisk";
            arch = "arm64";
            os = "linux";
            compression = "none";
            hash@1 {
                algo = "sha1";
            };
        };

        /* Take care to sync sync with platform_arm64.conf */
        fdt_ac5x {
            description = "Flattened Device Tree blob for AC5x";
            data = /incbin/("/usr/lib/linux-image-6.12.41+deb13-sonic-arm64/marvell/ac5-98dx35xx-rd.dtb");
            type = "flat_dt";
            arch = "arm64";
            compression = "none";
            load = <0x2 0x1000000>;
            hash@1 {
                algo = "sha1";
            };
        };
        fdt_7215_a1 {
            description = "Flattened Device Tree blob for 7215_IXS_A1";
            data = /incbin/("/usr/lib/linux-image-6.12.41+deb13-sonic-arm64/marvell/7215-ixs-a1.dtb");
            type = "flat_dt";
            arch = "arm64";
            compression = "none";
            load = <0x11000000>;
            hash@1 {
                algo = "sha1";
            };
        };
        fdt_cn9131 {
            description = "Flattened Device Tree blob for cn9131";
            data = /incbin/("/usr/lib/linux-image-6.12.41+deb13-sonic-arm64/marvell/cn9131-db-comexpress.dtb");
            type = "flat_dt";
            arch = "arm64";
            compression = "none";
            load = <0x0a00000>;
            entry = <0x0a00000>;
            hash@1 {
                algo = "sha1";
            };
        };
        /* Vendor dtb, shipped via sonic-device-data (installed before mkimage) */
        fdt_ecs5550-30x {
            description = "Flattened Device Tree blob for Accton ECS5550-30X";
            data = /incbin/("/usr/share/sonic/device/arm64-accton_ecs5550_30x-r0/ecs5550-30x.dtb");
            type = "flat_dt";
            arch = "arm64";
            compression = "none";
            load = <0x5400000>;
            hash@1 {
                algo = "sha1";
            };
        };
    };

    /* From Uboot env fit_conf_name=#conf_cn9131 */
    configurations {
        default = "conf_ac5x";
        conf_ac5x {
            description = "Boot Linux kernel with FDT blob + ramdisk for RD_AC5x";
            kernel = "kernel_ac5x";
            ramdisk = "ramdisk_ac5x";
            fdt = "fdt_ac5x";
            hash@1 {
                algo = "sha1";
            };
        };
        conf_7215_a1 {
            description = "Boot Linux kernel with FDT blob + ramdisk for 7125_IXS_A1";
            kernel = "kernel_7215_a1";
            ramdisk = "ramdisk_7215_a1";
            fdt = "fdt_7215_a1";
            hash@1 {
                algo = "sha1";
            };
        };
        conf_cn9131 {
            description = "Boot Linux kernel with FDT blob + ramdisk for CN9131";
            kernel = "kernel_cn9131";
            ramdisk = "ramdisk_cn9131";
            fdt = "fdt_cn9131";
            hash@1 {
                algo = "sha1";
            };
        };
        /* Same name as the vendor FIT, so sonic_image_2 (which reuses
         * $fit_conf_name) can still boot the previous vendor image. */
        conf_ecs5550-30x {
            description = "Boot Linux kernel with FDT blob + ramdisk for Accton ECS5550-30X";
            kernel = "kernel_aldrin2";
            ramdisk = "ramdisk_aldrin2";
            fdt = "fdt_ecs5550-30x";
            hash@1 {
                algo = "sha1";
            };
        };
   };
};
```
